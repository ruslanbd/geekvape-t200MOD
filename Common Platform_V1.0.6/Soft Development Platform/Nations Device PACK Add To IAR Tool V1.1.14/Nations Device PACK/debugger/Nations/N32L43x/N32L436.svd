# N32L436 register map
Vendor: Nationstech Ltd.; File version: 1.0
Registers are 32-bit, read-write, reset 0x0 unless marked. A register's access mark holds for its fields unless they carry their own. Offsets are from the block's base; lines under a group give offsets from that group; [hi:lo] are bit positions; {n}, {i} and the like mark numbered series; 'fields as' and 'values as' point back to an identical list; <NAME> marks a mode.

## Memory map
0x40000000 TIM2 size 0x400 — General purpose timer
0x40000400 TIM3 size 0x400 — General purpose timer
0x40000800 TIM4 size 0x400 — General purpose timer
0x40000C00 TIM5 size 0x400 — General purpose timer
0x40001000 TIM6 size 0x400 — Basic timer
0x40001400 TIM7 size 0x400
0x40002000 OPAMP size 0x400 — operational amplifier
0x40002400 COMP size 0x400 — comparator
0x40002800 RTC size 0x400 — Real time clock
0x40002C00 WWDG size 0x400 — window watchdog
0x40003000 IWDG size 0x400 — Independent watchdog
0x40003400 TSC size 0x400 — touch screen control
0x40003800 LPRCNT size 0x400 — low power rotation counter control
0x40003C00 TIM9 size 0x400 — General purpose timer
0x40004000 LCD size 0x400 — Liquid Crystal Display
0x40004400 USART2 size 0x400
0x40004800 USART3 size 0x400
0x40004C00 LPTIM size 0x400 — Low power timer control
0x40005000 LPUART size 0x400 — Low-power universal asynchronous receiver transmitter
0x40005400 I2C1 size 0x400 — Inter integrated circuit
0x40005800 I2C2 size 0x400
0x40005C00 USB size 0x400 — Universal serial bus full-speed device interface
0x40006400 CAN size 0x400 — Controller area network
0x40007000 PWR size 0x400 — Power control
0x40007400 DAC size 0x38 — digital to analog converter
0x40010000 AFIO size 0x400 — Alternate function I/O
0x40010400 EXTI size 0x20 — external interrupt/event controller
0x40010800 GPIOA size 0x400 — General purpose I/O
0x40010C00 GPIOB size 0x400
0x40011000 GPIOC size 0x400
0x40011400 GPIOD size 0x400
0x40012C00 TIM1 size 0x400 — Advanced timer
0x40013000 SPI1 size 0x400 — Serial peripheral interface
0x40013400 TIM8 size 0x400 — Advanced timer
0x40013800 USART1 size 0x400 — Universal synchronous asynchronous receiver transmitter
0x40013C00 SPI2 size 0x400 — Serial peripheral interface
0x40015000 UART4 size 0x400 — Universal asynchronous receiver transmitter
0x40015400 UART5 size 0x400
0x40020000 DMA size 0x400 — Direct memory access controller
0x40020800 ADC size 0x400 — analog to digital converter
0x40021000 RCC size 0x40 — Reset and clock control
0x40022000 FLASH size 0x38 — interal FLASH controller
0x40023000 CRC size 0x20 — cyclic redundancy check
0xE0042000 DBG size 0x400 — debug support for MCU

## Interrupts
0 WWDG — WWDG interrupt
1 PVD (PWR) — PVD through EXTI line detection interrupt
2 RTC_TAMPER_STAMP (RTC) — RTC Tamper interrupt or Timestamp through EXTI line 19
3 RTC_WKUP (RTC) — RTC wakeup timer through EXTI line 20 interrupt
4 FLASH — FLASH interrupt
5 RCC — RCC interrupt
6 EXTI0 (EXTI) — EXTI0 interrupt
7 EXTI1 (EXTI) — EXTI1 interrupt
8 EXTI2 (EXTI) — EXTI2 interrupt
9 EXTI3 (EXTI) — EXTI3 interrupt
10 EXTI4 (EXTI) — EXTI4 interrupt
{n+10} DMA_Channel{n} (DMA) (n=1..8) — DMA channel{n} global interrupt
19 ADC — ADC global interrupt
20 USB_HP (USB) — USB Device High Priority interrupt
21 USB_LP (USB) — USB Device Low Priority interrupt
22 COMP — COMP1/2 global interrupt through EXTI line 21/22
23 EXTI9_5 (EXTI) — EXTI5/6/7/8/9 interrupt
24 TIM1_BRK (TIM1) — TIM1 Break interrupt
25 TIM1_UP (TIM1) — TIM1 Update interrupt
26 TIM1_TRG_COM (TIM1) — TIM1 Trigger and Commutation interrupts
27 TIM1_CC (TIM1) — TIM1 Capture Compare interrupt
28 TIM2 — TIM2 global interrupt
29 TIM3 — TIM3 global interrupt
30 TIM4 — TIM4 global interrupt
31 I2C1_EV (I2C1) — I2C1 Event interrupt
32 I2C1_ER (I2C1) — I2C1 Error interrupt
33 I2C2_EV (I2C2) — I2C2 Event interrupt
34 I2C2_ER (I2C2) — I2C2 Error interrupt
35 SPI1 — SPI1 global interrupt
36 SPI2 — SPI2 global interrupt
37 USART1 — USART1 global interrupt
38 USART2 — USART2 global interrupt
39 USART3 — USART3 global interrupt
40 EXTI15_10 (EXTI) — EXTI10/11/12/13/14/15 interrupt
41 RTC_Alarm (RTC) — RTC Alarm through EXTI Line 17 Interrupt
42 USBWakeUp (USB) — USB Device WakeUp from suspend through EXTI Line interrupt
43 TIM8_BRK (TIM8) — TIM8 Break interrupt
44 TIM8_UP (TIM8) — TIM8 Update interrupt
45 TIM8_TRG_COM (TIM8) — TIM8 Trigger and Commutation interrupts
46 TIM8_CC (TIM8) — TIM8 Capture Compare interrupt
47 UART4 — UART4 global interrupt
48 UART5 — UART5 global interrupt
49 LPUART — LPUART global interrupt
50 TIM5 — TIM5 global interrupt
51 TIM6 — TIM6 global interrupt
52 TIM7 — TIM7 global interrupt
53 CAN_TX (CAN) — CAN TX interrupts
54 CAN_RX0 (CAN) — CAN RX0 interrupts
55 CAN_RX1 (CAN) — CAN RX1 interrupts
56 CAN_SCE (CAN) — CAN SCE interrupt
57 LPUART_WKUP (LPUART) — LPUART wakeup interrupt
58 LPTIM_WKUP (LPTIM) — LPTIMER wakeup interrupt
59 LCD — LCD global interrupt
62 TSC — TSC global interrupt
64 TIM9 — TIM9 global interrupt
152 LPRCNT — LPRCNT turns overflow interrupt
